## drivers/input/fingerprint/Kconfig
```kconfig
menu "Fingerprint Drivers"

source "drivers/input/fingerprint/fpc1020/Kconfig"
source "drivers/input/fingerprint/gf3208/Kconfig"

endmenu
```

## drivers/platform/xiaomi/Kconfig
```kconfig
# Xiaomi configuration options

config MACH_XIAOMI
	bool "Xiaomi device"
	depends on ARCH_QCOM
	help
	  Support for Xiaomi products

config MACH_XIAOMI_SDM660
	bool "Xiaomi SDM660"
	depends on ARCH_QCOM
	select MACH_XIAOMI
	help
	  Support for Xiaomi SDM660 devices

menu "Xiaomi board selection"

	config MACH_XIAOMI_WAYNE_COMMON
		bool "Xiaomi wayne common board"
		select MACH_XIAOMI_SDM660
		help
		  Support for Xiaomi MI A2/6X variant

endmenu
```
