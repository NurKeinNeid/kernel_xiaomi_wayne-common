#include "msm-audio-wayne-common.dtsi"
#include "msm-pm660-wayne-common.dtsi"
#include "msm-pm660l-wayne-common.dtsi"
#include "sdm660-audio-wayne-common.dtsi"
#include "sdm660-blsp-wayne-common.dtsi"
#include "sdm660-camera-wayne-common.dtsi"
#include "sdm660-camera-sensor-mtp-wayne-common.dtsi"
#include "sdm660-common-wayne-common.dtsi"
#include "sdm660-internal-codec-wayne-common.dtsi"
#include "sdm660-wayne-common.dtsi"
#include "sdm660-mdss-panels-wayne-common.dtsi"
#include "sdm660-mtp-wayne-common.dtsi"
#include "sdm660-pinctrl-wayne-common.dtsi"
#include "sdm660-regulator-wayne-common.dtsi"
